## meta-lumenvault/conf/layer.conf
```bitbake
# We have a conf and classes directory, add to BBPATH
BBPATH .= ":${LAYERDIR}"

# We have recipes-* directories, add to BBFILES
BBFILES += "${LAYERDIR}/recipes-*/*/*.bb \
            ${LAYERDIR}/recipes-*/*/*.bbappend"

BBFILE_COLLECTIONS += "meta-lumenvault"
BBFILE_PATTERN_meta-lumenvault = "^${LAYERDIR}/"
BBFILE_PRIORITY_meta-lumenvault = "10"

LAYERDEPENDS_meta-lumenvault = "core"
LAYERSERIES_COMPAT_meta-lumenvault = "kirkstone"
```
